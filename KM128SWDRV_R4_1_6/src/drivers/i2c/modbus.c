/*
 * modbus.c从机服务程序
 *
 */ 
#include "types.h"
#include "modbus.h"
#include "common.h"
#include "gpio/gpio.h"
#include "drivers.h"
#include "headers/MKM34ZA5.h" 

uint8 receBuf[32]; //可能这个接收的数据 有问题 不是16位
uint8 checkoutError;
uint8 rececount;
uint8 receCount;
uint8 sendBuf[120];
uint8 sendCount;
uint8 sendPosi;
uint16 voltage=0x0034;
uint16  getRegisterVal(uint16 Addr,uint16 *tempData); 
union Data
{
char c[4];
float f;
}y;
 
//#include "usart.h"
uint8 localAddr=1;	
uint8 testCoil; 
uint16 testRegister; 
uint8 byteCount;

uint16 adcval[120];//={0x4048,0xf5c3};//={0.123,0.134};

extern uint8 ad_pos[120];

const uint8 auchCRCHi[] = { 
0x00, 0xC1, 0x81, 0x40, 0x01, 0xC0, 0x80, 0x41, 0x01, 0xC0,0x80, 0x41, 0x00, 0xC1, 0x81, 0x40, 0x01, 0xC0, 0x80, 0x41, 
0x00, 0xC1, 0x81, 0x40, 0x00, 0xC1, 0x81, 0x40, 0x01, 0xC0,0x80, 0x41, 0x01, 0xC0, 0x80, 0x41, 0x00, 0xC1, 0x81, 0x40, 
0x00, 0xC1, 0x81, 0x40, 0x01, 0xC0, 0x80, 0x41, 0x00, 0xC1,0x81, 0x40, 0x01, 0xC0, 0x80, 0x41, 0x01, 0xC0, 0x80, 0x41, 
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0x00, 0xC1, 0x81, 0x40, 0x01, 0xC0, 0x80, 0x41, 0x01, 0xC0,0x80, 0x41, 0x00, 0xC1, 0x81, 0x40} ; 


const uint8 auchCRCLo[] = { 
0x00, 0xC0, 0xC1, 0x01, 0xC3, 0x03, 0x02, 0xC2, 0xC6, 0x06,0x07, 0xC7, 0x05, 0xC5, 0xC4, 0x04, 0xCC, 0x0C, 0x0D, 0xCD, 
0x0F, 0xCF, 0xCE, 0x0E, 0x0A, 0xCA, 0xCB, 0x0B, 0xC9, 0x09,0x08, 0xC8, 0xD8, 0x18, 0x19, 0xD9, 0x1B, 0xDB, 0xDA, 0x1A, 
0x1E, 0xDE, 0xDF, 0x1F, 0xDD, 0x1D, 0x1C, 0xDC, 0x14, 0xD4,0xD5, 0x15, 0xD7, 0x17, 0x16, 0xD6, 0xD2, 0x12, 0x13, 0xD3, 
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0x44, 0x84, 0x85, 0x45, 0x87, 0x47, 0x46, 0x86, 0x82, 0x42,0x43, 0x83, 0x41, 0x81, 0x80, 0x40} ;
uint16   crc16(uint8 *puchMsg, uint16 usDataLen) //*puchMsg要进行CRC校验的消息 
{                                               // usDataLen消息中字节数
	uint8 uchCRCHi = 0xFF ;/*高CRC字节初始化*/ 
        
        
        
	uint8 uchCRCLo = 0xFF ; /*低CRC初始化*/
	uint32 uIndex ; 
	while (usDataLen--) 
	{ 
		uIndex =uchCRCHi ^ *puchMsg++ ; //16位的CRC寄存器高8位与第一个8位二进制数据 相异或
		uchCRCHi = uchCRCLo ^ auchCRCHi[uIndex] ; 
		uchCRCLo = auchCRCLo[uIndex] ; 
	} 
	return (uchCRCHi<<8|uchCRCLo) ; 
}//uint16 crc16(uint8 *puchMsg, uint16 usDataLen)


void checkComm0Modbus(void)
{
// y.f=3.14;
// adcval[0]=y.c[0];
uint16 crcData;
uint16 tempData;
if(receCount>4)
{
  switch(receBuf[1])
  {
  //case 1:
  case 3:
  case 5:
    if(receCount>=8)
    {
      
    UART0_BASE_PTR->C2&=~(1<<2);//关接收
      //GPIO_Set(GPIOD,PIN4);//拉高发送
      receCount=0;
      if(receBuf[0]==localAddr && checkoutError==0) //判断是不是本机地址
       crcData=crc16(receBuf,6); //计算校验对不对 // 后来要加上
       if(crcData == receBuf[7]+(receBuf[6]<<8)) //校验正确
         if(receBuf[1]==1) //功能号是 01
         {
           // readCoil();//读线圈
         }
       else if(receBuf[1]==3)
       {
       readRegisrers();//读寄存器  /*读寄存器的过程手被关了*/
       }
       else if(receBuf[1]==5)
       {
       // forceSingleCoil();//设置单个线圈 
       }
       rececount=0;
       checkoutError=0;//表示一帧已经结束
    UART0_BASE_PTR->C2|=(1<<2);//开接收
      
     //  while(!UART_TxIdle(UART0));
        GPIO_Clr(GPIOD,PIN4);//拉低接收
    } break;
    default:
      receCount = 0;
      checkoutError =0 ;
      break;	
    

  }
}
}

void readRegisrers(void)
{
      y.f=voltage3;
      adcval[0]=y.c[0]+(y.c[1]<<8);
      adcval[1]=y.c[2]+(y.c[3]<<8);
uint8 addr;
uint8 tempAddr;
uint16 crcData;
uint8 readCount;//读到的两个字节数据
uint8 byteCount;//换算成的字节
uint16 i=0;
uint16 tempData=0;
//addr=(receBuf[2]<<8)+receBuf[3];
addr=receBuf[3];
tempAddr=addr;
readCount=receBuf[5];//数据字节数
//readCount=(receBuf[4]<<8)+receBuf[5];
byteCount=readCount*2;
for(i=0;i<byteCount;i+=2,tempAddr++)//地址加1数据加2
{
getRegisterVal(tempAddr, &tempData);
sendBuf[i+3]=tempData>>8;
sendBuf[i+4]=tempData&0xff;
}
//sendBuf[i+3]=voltage>>8;//发送电压数据 高字节
//sendBuf[i+4]=voltage&0xff;

sendBuf[0]=localAddr;//从机地址
sendBuf[1]=receBuf[1]; //03功能号
sendBuf[2]=byteCount;//数据字节数
byteCount += 3; //3+4  //招2个数据
crcData=crc16(sendBuf,byteCount);//
sendBuf[byteCount] = crcData >> 8; //高字节
byteCount++;//sendBuf[]
sendBuf[byteCount]=crcData&0xff;//低字节
sendCount=byteCount+2;
  
beginSend();
}

void beginSend(void)
{
  GPIO_Set(GPIOD,PIN4);//设为发送
  sendPosi = 0;//之前的
 
 do
  {
   while(!UART_TxIdle(UART0));
  UART_PutChar(UART0,sendBuf[sendPosi]);
  sendPosi++; 
  }while(sendPosi <sendCount);
//   if(sendCount>1)
//  sendCount--;
//  UART_PutChar(UART0,sendBuf[0]);
  
}

uint16  getRegisterVal(uint16 addr,uint16 *tempData)  //addr数据地址 
{
 uint16 result=0;
 uint16 ge,shi;
 ge=addr%10;
 shi=addr/10;
 switch(ge&0xff)
  {
 case 0:
        *tempData=adcval[shi*10];
        break;
 case 1:
        *tempData=adcval[shi*10+1];
        break;
 case 2:
        *tempData=adcval[shi*10+2];
        break;
 case 3: 
        *tempData=adcval[shi*10+3];
        break;
 case 4: 
        *tempData=adcval[shi*10+4];
        break;
 case 5:
        *tempData=adcval[shi*10+5];
        break;
 case 6:
        *tempData=adcval[shi*10+6];
        break;
 case 7:
        *tempData=adcval[shi*10+7];
        break;
 case 8:
        *tempData=adcval[shi*10+8];
        break;
 case 9: 
        *tempData=adcval[shi*10+9];
        break;
 default:
       break;
    }
  return result; 
}